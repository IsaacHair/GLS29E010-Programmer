 #define LEN 32
uint8_t prog[LEN][51]={ //ram: 0000-0001 = index of pointer; 0100-0102 = counting flags; 0103 = carry flag; 0200-0203 = pointer; 0300-030F = number incremented
                        //program: 00XX -> reset each incrementation; 01XX -> increment index of pointer; 02XX -> increment pointer based on index; 03XX -> increment and print number
    {0,0,0,0,0,0,0,0, 0,0,0,0,0,0,0,0, 1,0,0, 1,1,1,1,1,1,1,1, 1,1,1,1,1,1,1,1, 0,0,0,0,0,0,0,0, 0,0,0,0,0,0,0,1}, //reset each incrementation
    {0,0,0,0,0,0,0,0, 0,0,0,0,0,0,0,1, 0,1,0, 1,1,1,1,1,1,1,1, 1,1,1,1,1,1,1,1, 0,0,0,0,0,0,0,0, 0,0,0,0,0,0,1,0},
    {0,0,0,0,0,0,0,0, 0,0,0,0,0,0,1,0, 1,1,0, 0,0,0,0,0,0,0,0, 0,0,0,0,0,0,0,0, 0,0,0,0,0,0,0,0, 0,0,0,0,0,0,1,1},
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    {0,0,0,0,0,0,0,0, 0,0,0,1,1,1,1,1, 1,0,1, 0,0,0,0,0,0,0,0, 0,0,0,0,0,0,0,0, 0,0,0,0,0,0,0,0, 0,0,0,0,0,0,0,0},
    };


void setup() {
  int i, j;

  for (i = 0; i < 54; i++)
    pinMode(i, OUTPUT);

  digitalWrite(52, HIGH);
  digitalWrite(53, HIGH);
  
  for (i = 0; i < 160; i++, delay(50))
    if (i%2)
      digitalWrite(19, HIGH);
    else
      digitalWrite(19, LOW);

  for (i = 0; i < LEN; i++) {
    for (j = 0; j < 52; j++)
      digitalWrite(j, LOW);

    for (j = 0; j < 16; j++)
      if (prog[i][j])
        digitalWrite(51-j*2, HIGH);

    for (j = 35; j < 51; j++)
      if (prog[i][j])
        digitalWrite(120-j*2, HIGH);

    for (j = 16; j < 19; j++)
      if (prog[i][j])
        digitalWrite(j, HIGH);

    for (j = 19; j < 35; j++)
      if (prog[i][j])
        digitalWrite(j-19, HIGH);

    delay(10);
    digitalWrite(52, LOW);
    delay(10);
    digitalWrite(52, HIGH);
    delay(10);
  }

  digitalWrite(52, HIGH);
  digitalWrite(53, LOW);

  for (i = 0; i < 52; i++)
    pinMode(i, INPUT);
}

void loop() {

}
