#define ADR 22
#define DATA 40
#define WE 50
#define OE 51
#define CE 52

int buff[200];

struct {
  int line[128];
  int data[128];
  int len;
  long adr;
} prog;


long examplec = 0;
long example[1141] = {0x0000, 0x00, 0x01, 0x40, 0x01, 0x60, 0x06, -1, 0x0080, 0x00, 0x01, 0x01, 0x01,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 -1, -2};

void setup() {
  Serial.begin(9600);
  while(!Serial)
    delay(10);
  int i;
  pinMode(WE, OUTPUT);
  digitalWrite(WE, HIGH);
  pinMode(OE, OUTPUT);
  digitalWrite(OE, HIGH);
  pinMode(CE, OUTPUT);
  digitalWrite(CE, LOW);
  for (i = 0; i < 17; i++)
    pinMode(ADR+i, OUTPUT);
  
  while (grabpage()) {
    pagewrite();
    if (errors())
      pagewrite();
  }

  grabreset();
  while (grabpage()) {
    Serial.print("page:");
    Serial.print(prog.adr);
    Serial.print(" errors:");
    Serial.println(errors());
  }
}

int grabpage() {
  int i, j;
  i = examplec;
  if (example[i] == -2)
    return (0);
  prog.adr = example[i];
  i++;
  for (j = 0; 1; j++)
    if (example[i] == -1) {
      prog.len = j;
      examplec = i+1;
      return (1);
    }
    else {
      prog.line[j] = example[i];
      prog.data[j] = example[i+1];
      i += 2;
    }
}

void grabreset() {
  examplec = 0;
}

void pagewrite() {
  int j, k;
  int i;
  for (i = 0; i < 8; i++)
    pinMode(DATA+i, OUTPUT);
  digitalWrite(WE, HIGH);
  digitalWrite(OE, HIGH);
  digitalWrite(ADR+15, HIGH);
  digitalWrite(ADR+16, HIGH);
  setcomm(0x5555);
  setdata(0xAA);
  digitalWrite(WE, LOW);
  digitalWrite(WE, HIGH);
  setcomm(0x2AAA);
  setdata(0x55);
  digitalWrite(WE, LOW);
  digitalWrite(WE, HIGH);
  setcomm(0x5555);
  setdata(0xA0);
  digitalWrite(WE, LOW);
  digitalWrite(WE, HIGH);
  setpage(prog.adr);
  for (j = 0; j < prog.len; j++) {
    Serial.print("page:");
    Serial.print(prog.adr);
    Serial.print(" line:");
    Serial.print(prog.line[j]);
    Serial.print(" wrote data:");
    Serial.println(prog.data[j]);
    digitalWrite(WE, HIGH);
    setline(prog.line[j]);
    setdata(prog.data[j]);
    digitalWrite(WE, LOW);
  }
  digitalWrite(WE, HIGH);
  delay(25);
}

void setdata(int data) {
  int k;
  for (k = 0; k < 8; k++)
    if (data & (1 << k))
      digitalWrite(DATA+k, HIGH);
    else
      digitalWrite(DATA+k, LOW);
}

void setpage(long page) {
  int k;
  for (k = 0; k < 17; k++)
    if (page & (1 << k))
      digitalWrite(ADR+k, HIGH);
    else
      digitalWrite(ADR+k, LOW);
}

void setcomm(int comm) {
  int k;
  for (k = 0; k < 15; k++)
    if (comm & (1 << k))
      digitalWrite(ADR+k, HIGH);
    else
      digitalWrite(ADR+k, LOW);
}

void setline(int line) {
  int k;
  for (k = 0; k < 7; k++)
    if (line & (1 << k))
      digitalWrite(ADR+k, HIGH);
    else
      digitalWrite(ADR+k, LOW);
}

int errors() {
  int j;
  int i;
  int err;
  for (i = 0; i < 8; i++)
    pinMode(DATA+i, INPUT);
  digitalWrite(WE, HIGH);
  digitalWrite(OE, LOW);
  setpage(prog.adr);
  for (j = 0, err = 0; j < prog.len; j++) {
    setline(prog.line[j]);
    if (readdata() != prog.data[j])
      err++;
    Serial.print("page:");
    Serial.print(prog.adr);
    Serial.print(" line:");
    Serial.print(prog.line[j]);
    Serial.print(" read data:");
    Serial.println(readdata());
  }
  return (err);
}

int readdata() {
  int k;
  int ret;
  for (k = 0, ret = 0; k < 8; k++)
    if (digitalRead(DATA+k))
      ret += (1 << k);
  return (ret);
}

void loop() {}
