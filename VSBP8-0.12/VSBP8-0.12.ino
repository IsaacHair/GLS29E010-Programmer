#define ADR 22
#define DATA 40
#define WE 50
#define OE 51
#define CE 52

char buff[200];

#define LEN 1140
long prog[LEN] = {0x0000, 0x00, 0x08, 0x40, 0x08, 0x60, 0x08, -1, 0x0080, 0x00, 0x08, 0x01, 0x0a,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 -1, -2};
void setup() {
  Serial.begin(115200);
  while(!Serial)
    delay(10);
  int i;
  int len;
  for (i = 22; i <= 53; i++)
    pinMode(i, INPUT);

  pinMode(WE, OUTPUT);
  digitalWrite(WE, HIGH);
  pinMode(OE, OUTPUT);
  digitalWrite(OE, HIGH);
  pinMode(CE, OUTPUT);
  digitalWrite(CE, LOW);
  for (i = 0; i < 17; i++)
    pinMode(ADR+i, OUTPUT);
  for (i = 0; i < 8; i++)
    pinMode(DATA+i, OUTPUT);
  page();

  for (i = 0; i < 8; i++)
    pinMode(DATA+i, INPUT);
  showall();
}

void page()
{
  long i, j;
  int pagehere;
  long pagen;
  for (i = 0, pagehere = 1; i < LEN;) {
    if (prog[i] == -2)
      break;
    else if (pagehere) {
      def(0x5555, 0xAA);
      def(0x2AAA, 0x55);
      def(0x5555, 0xA0);
      pagen = prog[i];
      pagehere = 0;
      i++;
    }
    else if (prog[i] == -1) {
      pagehere = 1;
      digitalWrite(WE, HIGH);
      delay(20);
      i++;
    }
    else {
      def(pagen+prog[i], prog[i+1]);
      i += 2;
    }
  }
}

void setadr(long a)
{
  long i;
  for (i = 0; i < 17; i++)
    digitalWrite(ADR+i, LOW);
  for (i = 0; i < 17; i++)
    if (a & (1 << i))
      digitalWrite(ADR+i, HIGH);
}

void setval(int v)
{
  long i;
  for (i = 0; i < 8; i++)
    digitalWrite(DATA+i, LOW);
  for (i = 0; i < 8; i++)
    if (v & (1 << i))
      digitalWrite(DATA+i, HIGH);
}

void def(long a, int v)
{
  long i;
  setadr(a);
  digitalWrite(WE, HIGH);
  delayMicroseconds(5);
  digitalWrite(WE, LOW);
  setval(v);
}

int show(long a)
{
  long i;
  int val;
  digitalWrite(OE, LOW);
  setadr(a);
  delayMicroseconds(5);
  for (val = 0, i = 0; i < 8; i++)
    if (digitalRead(DATA+i))
      val += (1 << i);
  digitalWrite(OE, HIGH);
  return (val);
}

long showall()
{
  long i, j;
  long pagen;
  int pagehere;
  long pageindex;
  long err;
  for (i = 0, err = 0, pagehere = 1; i < LEN;) {
    if (prog[i] == -2)
      break;
    if (pagehere) {
      pagen = prog[i];
      pageindex = i;
      pagehere = 0;
      i++;
    }
    else if (prog[i] == -1) {
      pagehere = 1;
      i++;
    }
    else {
      if (!(show(pagen+prog[i]) == prog[i+1])) {
        Serial.println(show(pagen+prog[i]));
        err++;
      }
      i += 2;
    }
  }
  Serial.print("errors:");
  Serial.println(err);
  Serial.flush();
  return (err);
}

void loop() {}
