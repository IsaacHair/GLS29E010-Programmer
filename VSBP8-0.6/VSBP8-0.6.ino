#define ADR 22
#define DATA 40
#define WE 50
#define OE 51
#define CE 52

char buff[200];

#define LEN 1140
long prog[LEN] = {0x0000, 0x00, 0x08, 0x40, 0x08, 0x60, 0x08, -1, 0x0080, 0x00, 0x08, 0x01, 0x0a,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 0xa4, -1};

void setup() {
  Serial.begin(9600);
  while(!Serial)
    delay(10);
  int i;
  int len;
  for (i = 22; i <= 53; i++)
    pinMode(i, INPUT);
  pinMode(WE, OUTPUT);
  digitalWrite(WE, HIGH);
  pinMode(OE, OUTPUT);
  digitalWrite(OE, HIGH);
  pinMode(CE, OUTPUT);
  digitalWrite(CE, LOW);

  for (i = 0; i < 17; i++)
    pinMode(ADR+i, OUTPUT);
  for (i = 0; i < 8; i++)
    pinMode(DATA+i, OUTPUT);
  page();

  for (i = 0; i < 8; i++)
    pinMode(DATA+i, INPUT);
  Serial.println(show(0x0060)); //should be 0x08
  Serial.println(show(0x0080)); //should be 0x0a
  Serial.println(show(0x15a0)); //should be 0x50
}

void page()
{
  long i, j;
  int pagehere;
  long page;
  for (i = 0, pagehere = 1; i < LEN; i++) {
    if (pagehere) {
      def(0x15555, 0xAA);
      def(0x12AAA, 0x55);
      def(0x15555, 0xA0);
      page = prog[i];
      for (j = 0; j < 16; j++)
        def(page, 0xff);
      pagehere = 0;
      continue;
    }
    else if (prog[i] == -1) {
      pagehere = 1;
      delay(20);
      continue;
    }
    else {
      def(page+prog[i], prog[i+1]);
      i++;
    }
  }
}

void setadr(long a)
{
  long i;
  for (i = 0; i < 17; i++)
    digitalWrite(ADR+i, LOW);
  for (i = 0; i < 17; i++)
    if (a & (1 << i))
      digitalWrite(ADR+i, HIGH);
}

void setval(int v)
{
  long i;
  for (i = 0; i < 8; i++)
    digitalWrite(DATA+i, LOW);
  for (i = 0; i < 8; i++)
    if (v & (1 << i))
      digitalWrite(DATA+i, HIGH);
}

void def(long a, int v)
{
  long i;
  setadr(a);
  digitalWrite(WE, HIGH);
  delayMicroseconds(5);
  digitalWrite(WE, LOW);
  setval(v);
}

int show(long a)
{
  long i;
  int val;
  digitalWrite(OE, LOW);
  setadr(a);
  for (val = 0, i = 0; i < 8; i++)
    if (digitalRead(DATA+i))
      val += (1 << i);
  digitalWrite(OE, HIGH);
  return (val);
}

void loop() {}
